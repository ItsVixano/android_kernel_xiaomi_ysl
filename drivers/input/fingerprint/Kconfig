## drivers/input/fingerprint/Kconfig
```kconfig
config INPUT_FINGERPRINT
	 tristate "Fingerprint driver support"
	 help
	 Say Y here to enable goodix fingerprint driver support!
```

## drivers/input/touchscreen/gt917d_e6/Kconfig
```kconfig
#
# Goodix GT9xx Touchscreen driver
#

config TOUCHSCREEN_GT917D_E6
	tristate "Goodix GT9xx touchpanel driver"
	depends on TOUCHSCREEN_GT9XX_E6
	default n
	help
	  This is the main file for touchpanel driver for Goodix GT9xx
	  touchscreens.

	  Say Y here if you have a Goodix GT9xx touchscreen connected
	  to your system.

	  If unsure, say N.

	  To compile this driver as a module, choose M here: the
	  module will be called gt9xx_update.
```

## drivers/platform/xiaomi/Kconfig
```kconfig
# Xiaomi configuration options

config MACH_XIAOMI_MSM8953
	bool "Xiaomi MSM8953 devices"
	help
	  Support for Xiaomi MSM8953 variants

menu "Xiaomi MSM8953 board selection"

config MACH_XIAOMI_YSL
        bool "xiaomi ysl board"
        select MACH_XIAOMI_MSM8953
        help
          Support for Xiaomi Redmi S2

endmenu
```
